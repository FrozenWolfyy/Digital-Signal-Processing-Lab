float x[75]={-87.1730763754109,-109.549533301984,11.0003744438626,163.428651083375,199.149769274291,123.566000275567,56.2555857920532,11.8749570339706,-18.9772981263296,-42.9850713923412,-49.5043245212337,-44.9581951553012,-33.9320664244114,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-17.7793426698177
  };

float len=75;               //no of samples
double y[75][75];
double z[75][75];
float X[75];
float Y[75];
float sum1;
float sum2;
float Mag_spec[75];
float m1=0;
float index_1=0;
float m2=0;
float index_2=0;
double sum;
float count=8;
float l=4;

float p[75];

void setup() {
Serial.begin(9600);

for(int i=0;i<75;i++)
Serial.println(x[i]);         //printing data

for(int i=0;i<75;i++)
{
   sum=0;                    // initialize a variable to store the sum value
  for(int k=0;k<l;k++)
  {
   sum=sum+x[i-k];                   // sum of the past l values.
  } 
p[i]=sum/count;                   // averaging them.
}

//for(int i=0;i<75;i++)
//Serial.println(p[i]);


for(int i=0;i<len;i++)
{
  for(int j=0;j<len;j++)
  {
    y[i][j] = cos(2*3.14*i*j/75);
    z[i][j] = -sin(2*3.14*i*j/75);
    }
  }

for(int i=0;i<len;i++)
{
  sum1=0;
  sum2=0;
  for(int j=0;j<len;j++)
  {
   sum1=sum1+p[j]*y[i][j];
   sum2=sum2+p[j]*z[i][j]; 
    }
    X[i]=sum1*sum1;
    Y[i]=sum2*sum2;
    Mag_spec[i]=sqrt(X[i]+Y[i]);
  }



//for(int i=0;i<len;i++)
//{
//  Serial.print()
//  Serial.println(Mag_spec[i]);
//  }



for(int i=0;i<len/2;i++)
{
  if(m1<Mag_spec[i])
  {
    m1=max(m1,Mag_spec[i]);
    index_1=i;
    }
  }

for(int i=len/2;i<len;i++)
{
 if(m2<Mag_spec[i])
 {
  m2=Mag_spec[i];
  index_2=i;
  } 
  }  
//
//for(int i=0;i<75;i++)
//Serial.println(Mag_spec[i]);

 
//Serial.print(index_1); 
//Serial.print(','); 
//Serial.println(index_2); 
////  

}

void loop() {

}
